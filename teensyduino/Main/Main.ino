/*
 * This code was largely adapted from Jonathan's code and can be found at 
 * github.com/johnowhitaker/teensy_adc_tips
 * This code was especially helpful when reading from the ADC using DMA
 */

#include "ADC.h"
#include "DMAChannel.h"

#define oneHzSample 1000000/500  // sample for the 1Hz signal expressed in microseconds 
#define refVoltage 3.3
#define DACresolution 4095 //2^n - 1
#define ADCresolution 65535 //2^16-1
#define desiredOffset 1 //1.5
#define desiredAmplitude 1 //1.5

#define BUFFER_SIZE 24000  //24 000 samples were taken from each receiver and stored in buf_a and buf_b
#define SAMPLE_RATE 400000 //Sample rate of 400kHz
#define SAMPLE_AVERAGING 0                    // 0, 4, 8, 16 or 32
#define SAMPLING_GAIN 1                       // 1, 2, 4, 8, 16, 32 or 64
#define SAMPLE_RESOLUTION 16 //16 bit resolution

// Main Loop Flow
#define CHECKINPUT_INTERVAL   200         // 20 times per second .  50 000 8000 5000 3000
#define DISPLAY_INTERVAL      100000        // 10 times per second
#define SERIAL_PORT_SPEED     9600          // USB is always 12 Mbit/sec on teensy
#define DEBUG                 false

unsigned long lastInAvail;       //
unsigned long lastDisplay;       //
unsigned long lastBlink;         //
unsigned long currentTime;       //
unsigned long func_timer; // <<<<<<<<<<< Time execution of different functions
bool          STREAM  = false;
bool          VERBOSE = true;
bool          BINARY = true;

// I/O-Pins
const int readPin0             = A14;
const int readPin1             = A16;
const int ledPin               = LED_BUILTIN;

uint16_t chirp[]= {1, 1, 1, 1, 1, 1, 1, 1, 1, 1, 1, 1, 1,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 1, 1};

//ADC & DMA Config
ADC *adc = new ADC(); //adc object
DMAChannel dma0;
DMAChannel dma1;
// Variables for ADC0
DMAMEM static uint16_t buf_a[BUFFER_SIZE]; // buffer a
DMAMEM static uint16_t buf_b[BUFFER_SIZE]; // buffer b
volatile uint8_t          aorb_busy  = 0;  
volatile uint8_t          a_full     = 0;      
volatile uint8_t          b_full     = 0;    
uint32_t                    freq     = SAMPLE_RATE;
uint8_t                     aver     = SAMPLE_AVERAGING;
uint8_t                      res     = SAMPLE_RESOLUTION;
uint8_t                    sgain     = SAMPLING_GAIN;
float                       Vmax     = 3.3;
ADC_REFERENCE               Vref     = ADC_REFERENCE::REF_3V3;
ADC_SAMPLING_SPEED    samp_speed     = ADC_SAMPLING_SPEED::VERY_HIGH_SPEED;
ADC_CONVERSION_SPEED  conv_speed     = ADC_CONVERSION_SPEED::VERY_HIGH_SPEED;

void setup() { // =====================================================

  pinMode(LED_BUILTIN, OUTPUT);
  pinMode(readPin0, INPUT);
  pinMode(readPin1, INPUT);
  
  // clear buffers
  memset((void*)buf_a, 0, sizeof(buf_a));
  memset((void*)buf_b, 0, sizeof(buf_b));

} // setup =========================================================

int          inByte   = 0;
String inNumberString = "";
long         inNumber = -1;
boolean   chunk1_sent = false;
boolean   chunk2_sent = false;
boolean   chunk3_sent = false;

// Start adc0
void start_ADC0(void) {
    aorb_busy  = 1;
    a_full    = 0;
    adc->adc0->startSingleRead(readPin0);
    // frequency, hardware trigger and dma
    adc->adc0->startPDB(freq); // set ADC_SC2_ADTRG
    adc->enableDMA(ADC_0); // set ADC_SC2_DMAEN
    dma0.enable();
}

// Start adc1
void start_ADC1(void) {
    aorb_busy  = 1;
    b_full    = 0;
    adc->adc1->startSingleRead(readPin1);
    // frequency, hardware trigger and dma
    adc->adc1->startPDB(freq); // set ADC_SC2_ADTRG
    adc->enableDMA(ADC_1); // set ADC_SC2_DMAEN
    dma1.enable();
}

// Stops ADC0 and disables DMA0
void stop_ADC0(void) {
    PDB0_CH0C1 = 0; // diasble ADC0 pre triggers    
    dma0.disable();
    adc->disableDMA(ADC_0);
    adc->adc0->stopPDB();
    aorb_busy = 0;
}

// Stops ADC1 and disables DMA1
void stop_ADC1(void) {
    PDB0_CH1C1 = 0; // diasble ADC0 pre triggers    
    dma1.disable();
    adc->disableDMA(ADC_1);
    adc->adc0->stopPDB();
    aorb_busy = 0;
}

// Waits for ADC0 to finish the conversion
void wait_ADC_single0() {
  uint32_t   end_time = micros();
  uint32_t start_time = micros();
  while (!a_full) {
    end_time = micros();
    if ((end_time - start_time) > 11000000) {
      Serial.printf("Timeout %d %d\n", a_full, aorb_busy);
      break;
    }
  }
}

// Waits for ADC1 to finish the conversion
void wait_ADC_single1() {
  uint32_t   end_time = micros();
  uint32_t start_time = micros();
  while (!b_full) {
    end_time = micros();
    if ((end_time - start_time) > 11000000) {
      Serial.printf("Timeout %d %d\n", b_full, aorb_busy);
      break;
    }
  }
}

// Interrupt associated with dma0
void dma0_isr_single(void) {
  aorb_busy = 0;
  a_full = 1;
  dma0.clearInterrupt(); 
  dma0.clearComplete(); 
}

// Interrupt associated with dma1
void dma1_isr_single(void) {
  aorb_busy = 0;
  b_full = 1;
  dma1.clearInterrupt();
  dma1.clearComplete();
}

// CONVERT 16BITS TO HEX AND SEND OVER SERIAL PORT
void serial16Print(uint16_t u) {
  byte * b = (byte *) &u;
  for(int i=1; i>=0; i--) {
    
    byte b1 = (b[i] >> 4) & 0x0f;
    byte b2 = (b[i] & 0x0f);
    
    char c1 = (b1 < 10) ? ('0' + b1) : 'A' + b1 - 10;
    char c2 = (b2 < 10) ? ('0' + b2) : 'A' + b2 - 10;
    
    Serial.print(c1);
    Serial.print(c2);
  }
}

// Print the specified buffer over serial separated by '\n'
void printBuffer(uint16_t *buffer, size_t start, size_t end) {
  size_t i;
  if (VERBOSE) {
    for (i = start; i <= end; i++) { Serial.println(buffer[i]); }
  } else {
    for (i = start; i <= end; i++) {
      serial16Print(buffer[i]);
      Serial.println(); }
  }
}

// Initialise ADC 0
void setup_ADC_single0(void) {
  // clear buffers
  memset((void*)buf_a, 0, sizeof(buf_a));
  // Initialize the ADC
  if (sgain >1) { adc->enablePGA(sgain, ADC_0); }  else { adc->disablePGA(ADC_0); }         
  adc->setReference(Vref, ADC_0);
  adc->setAveraging(aver, ADC_0); 
  adc->setResolution(res, ADC_0); 
  if (((Vref == ADC_REFERENCE::REF_3V3) && (Vmax > 3.29)) || ((Vref == ADC_REFERENCE::REF_1V2) && (Vmax > 1.19))) { 
    adc->disableCompare(ADC_0);
  } else if (Vref == ADC_REFERENCE::REF_3V3) {
    adc->enableCompare(Vmax/3.3*adc->getMaxValue(ADC_0), 0, ADC_0);
  } else if (Vref == ADC_REFERENCE::REF_1V2) {
    adc->enableCompare(Vmax/1.2*adc->getMaxValue(ADC_0), 0, ADC_0);    
  }
  //adc->enableCompareRange(1.0*adc->getMaxValue(ADC_1)/3.3, 2.0*adc->getMaxValue(ADC_1)/3.3, 1, 1, ADC_1); // ready if value lies out of [1.0,2.0] V
  adc->setConversionSpeed(conv_speed, ADC_0);
  adc->setSamplingSpeed(samp_speed, ADC_0);      

  // Initialise dma0
  dma0.source((volatile uint16_t&)ADC0_RA);
  dma0.destinationBuffer(buf_a, sizeof(buf_a));
  dma0.triggerAtHardwareEvent(DMAMUX_SOURCE_ADC0);
  dma0.interruptAtCompletion();
  dma0.attachInterrupt(&dma0_isr_single);
}

// Initialise ADC 1
void setup_ADC_single1(void) {
  // clear buffers
  memset((void*)buf_b, 0, sizeof(buf_b));
  // Initialize the ADC
  if (sgain >1) { adc->enablePGA(sgain, ADC_1); }  else { adc->disablePGA(ADC_1); }         
  adc->setReference(Vref, ADC_1);
  adc->setAveraging(aver, ADC_1); 
  adc->setResolution(res, ADC_1); 
  if (((Vref == ADC_REFERENCE::REF_3V3) && (Vmax > 3.29)) || ((Vref == ADC_REFERENCE::REF_1V2) && (Vmax > 1.19))) { 
    adc->disableCompare(ADC_1);
  } else if (Vref == ADC_REFERENCE::REF_3V3) {
    adc->enableCompare(Vmax/3.3*adc->getMaxValue(ADC_1), 0, ADC_1);
  } else if (Vref == ADC_REFERENCE::REF_1V2) {
    adc->enableCompare(Vmax/1.2*adc->getMaxValue(ADC_1), 0, ADC_1);    
  }
  //adc->enableCompareRange(1.0*adc->getMaxValue(ADC_1)/3.3, 2.0*adc->getMaxValue(ADC_1)/3.3, 1, 1, ADC_1); // ready if value lies out of [1.0,2.0] V
  adc->setConversionSpeed(conv_speed, ADC_1);
  adc->setSamplingSpeed(samp_speed, ADC_1);      

  // Initialise dma1
  dma1.source((volatile uint16_t&)ADC1_RA);
  dma1.destinationBuffer(buf_b, sizeof(buf_b));
  dma1.triggerAtHardwareEvent(DMAMUX_SOURCE_ADC1);
  dma1.interruptAtCompletion();
  dma1.attachInterrupt(&dma1_isr_single);
}

void loop() { // ===================================================

  // Keep track of loop time
  currentTime = micros();
  
  if ((currentTime-lastInAvail) >= CHECKINPUT_INTERVAL) {
    lastInAvail = currentTime;
    
    if (Serial.available()) {
      inByte = Serial.read();

       if(inByte == 's')  { //send out chirp and read in echos
          setup_ADC_single0();
          setup_ADC_single1();
          unsigned int upper = (sizeof(chirp)/sizeof(chirp[0]));
          for(unsigned int i = 0; i < upper; i++){
              digitalWrite(13, chirp[i]); //pin 13 was used as it is connected to the LED. Therefore, LED flashes when chirp is being sent.
          }
          
          start_ADC0();
          start_ADC1();
          
          wait_ADC_single0();
          stop_ADC0(); 
          wait_ADC_single1();
          stop_ADC1();
          
          adc->printError();
          adc->resetError();
          
      } else if (inByte == 'a') { // print buffer a
          printBuffer(buf_a, 0, BUFFER_SIZE-1);
          
      } else if (inByte == 'b') { // print buffer bs 
          printBuffer(buf_b, 0, BUFFER_SIZE-1);
      }
    } // end if serial input available
  } // end check serial in time interval
    
  if ((currentTime-lastDisplay) >= DISPLAY_INTERVAL) {
    lastDisplay = currentTime;
    adc->printError();
    adc->resetError();
  } 

} // end loop ======================================================
